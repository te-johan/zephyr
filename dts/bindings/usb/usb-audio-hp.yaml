## dts/bindings/usb/usb-audio-hp.yaml
```yaml
# Copyright (c) 2020 Nordic Semiconductor ASA
# SPDX-License-Identifier: Apache-2.0

# Specific fields for USB audio headphones.

description: USB Audio headphones specific fields.

compatible: "usb-audio-hp"

include: usb-audio.yaml

properties:
  resolution:
    type: int
    default: 24
    required: false
    enum:
     - 8
     - 16
     - 24
     - 32
  ep-addr:
    type: int
    required: true
    description: ISO endpoint address.
```

## dts/bindings/usb/usb-audio-hs.yaml
```yaml
# Copyright (c) 2020 Nordic Semiconductor ASA
# SPDX-License-Identifier: Apache-2.0

# Specific fields for USB audio headset.

description: USB Audio headset specific fields.

compatible: "usb-audio-hs"

include: usb-audio.yaml

properties:
  ep-addr-mic:
    type: int
    required: true
    description: ISO IN endpoint address for microphone part.
  ep-addr-hp:
    type: int
    required: true
    description: ISO OUT endpoint address for headphones part.
  resolution-mic:
    type: int
    default: 16
    required: false
    enum:
     - 8
     - 16
     - 24
     - 32
  resolution-hp:
    type: int
    default: 24
    required: false
    enum:
     - 8
     - 16
     - 24
     - 32
```

## dts/bindings/usb/usb-audio-mic.yaml
```yaml
# Copyright (c) 2020 Nordic Semiconductor ASA
# SPDX-License-Identifier: Apache-2.0

# Specific fields for USB audio microphone.

description: USB Audio microphone specific fields.

compatible: "usb-audio-mic"

include: usb-audio.yaml

properties:
  resolution:
    type: int
    default: 16
    required: false
    enum:
     - 8
     - 16
     - 24
     - 32
  ep-addr:
    type: int
    required: true
    description: ISO endpoint address.
```

## subsys/usb/class/audio/Kconfig
```kconfig
# USB AUDIO configuration options

# Copyright (c) 2020 Nordic Semiconductor ASA
# SPDX-License-Identifier: Apache-2.0

config USB_DEVICE_AUDIO
	bool "USB Audio Device Class Driver"
	help
	  USB audio device class driver

if USB_DEVICE_AUDIO

config USB_AUDIO_DEVICE_NAME
	string "USB AUDIO device name template"
	default "AUDIO"
	help
	  Device name template for the AUDIO Devices.
	  Headphones device would have name
	  $(USB_AUDIO_DEVICE_NAME)_HP_0.
	  Microphone device would have name
	  $(USB_AUDIO_DEVICE_NAME)_MIC_0.
	  Headset device would have name
	  $(USB_AUDIO_DEVICE_NAME)_HS_0.

module = USB_AUDIO
module-str = USB Audio
source "subsys/logging/Kconfig.template.log_config"


module = USB_AUDIO_HEADPHONES
default-count = 0
source "subsys/usb/class/Kconfig.template.composite_device_number"

module = USB_AUDIO_MICROPHONE
default-count = 0
source "subsys/usb/class/Kconfig.template.composite_device_number"

module = USB_AUDIO_HEADSET
default-count = 0
source "subsys/usb/class/Kconfig.template.composite_device_number"

endif #USB_DEVICE_AUDIO
```
